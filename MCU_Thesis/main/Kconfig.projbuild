## MCU_Thesis/main/Kconfig.projbuild
```kconfig
menu "DS3231 Configuration"

    config SCL_GPIO
        int "DS3231 SCL GPIO number"
        range 0 34
        default 18
        help
            GPIO number (IOxx) to DS3231 SCL.
            Some GPIOs are used for other purposes (flash connections, etc.) and cannot be used to CS.
            GPIOs 35-39 are input-only so cannot be used as outputs.

    config SDA_GPIO
        int "DS3231 SDA GPIO number"
        range 0 34
        default 19
        help
            GPIO number (IOxx) to DS3231 SDA.
            Some GPIOs are used for other purposes (flash connections, etc.) and cannot be used to DC.
            GPIOs 35-39 are input-only so cannot be used as outputs.

    config TIMEZONE
        int "Your TimeZone"
        range 0 23
        default 7
        help
            Your local timezone.
            When it is 0, Greenwich Mean Time.

    choice MODE
        prompt "Access Mode"
        default SET_CLOCK
        help
            Select mode for the example.
        config SET_CLOCK
            bool "Set Clock & Get Clock"
            help
                Set clock to DS3213 & Get clock from DS3213.
        config GET_CLOCK
            bool "Only Get Clock"
            help
                Get clock from DS3213.
        config DIFF_CLOCK
            bool "Get the time difference"
            help
                Get the time difference of NTP and RTC.
    endchoice

if SET_CLOCK || DIFF_CLOCK
    config NTP_SERVER
        string "NTP Server"
        default "pool.ntp.org"
        help
            Hostname for NTP Server.
endif

endmenu

menu "Application Configuration"

	choice POLARITY
		prompt "Communication Polarity"
		default PRIMARY
		help
			Select Communication Polarity.
		config PRIMARY
			bool "Primary"
			help
				As Echo Client.
		config SECONDARY
			bool "Secondary"
			help
				As Echo Server.
	endchoice

	choice FREQUENCY
		prompt "Frequency to use"
		default 433MHZ
		help
			Select Frequency to use.
		config 169MHZ
			bool "169MHz"
			help
				Frequency is 169MHz.
		config 433MHZ
			bool "433MHz"
			help
				Frequency is 433MHz.
		config 470MHZ
			bool "470MHz"
			help
				Frequency is 470MHz.
		config 866MHZ
			bool "866MHz"
			help
				Frequency is 866MHz.
		config 915MHZ
			bool "915MHz"
			help
				Frequency is 915MHz.
		config OTHER
			bool "Other"
			help
				Other Frequency.
	endchoice

	config OTHER_FREQUENCY
		depends on OTHER
		int "Frequency to use[MHz]"
		range 1 999
		default 433
		help
			Frequency to use[MHz].

	config ADVANCED
		bool "Enable Advanced settings"
		default false
		help
			Enable Advanced settings.

	config CODING_RATE
		depends on ADVANCED
		int "Error coding rate"
		range 1 4
		default 1
		help
			Error coding rate.

	config BANDWIDTH
		depends on ADVANCED
		int "Signal Bandwidth"
		range 0 9
		default 7
		help
			Signal Bandwidth.

	config SF_RATE
		depends on ADVANCED
		int "Spreading Factor"
		range 5 12
		default 7
		help
			Spreading Factor.

endmenu 
```
